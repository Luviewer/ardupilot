## libraries/AP_HAL_RTT/rtt_bsp_pixhawk6c_mini/board/Kconfig
```kconfig
menu "Hardware Drivers Config"

menu "Onboard Peripheral Drivers"

    config BSP_USING_COM2
        bool "Enable COM2(485)"
        select BSP_USING_UART
        select BSP_USING_UART2
        select BSP_USING_I2C1
        select PKG_USING_PCF8574
        default n

    config BSP_USING_SDRAM
        bool "Enable SDRAM"
        select BSP_USING_FMC
        default n

    config BSP_USING_LCD
        bool "Enable LCD"
        select BSP_USING_LTDC
        select BSP_USING_SDRAM
        default n

    config BSP_USING_QSPI_FLASH
        bool "Enable QSPI FLASH (W25Q256 qspi)"
        select BSP_USING_QSPI
        select RT_USING_SFUD
        select RT_SFUD_USING_QSPI
        default n
    config BSP_USING_SDMMC
        bool "Enable SDMMC (SD card)"
        select RT_USING_SDIO
        select RT_USING_DFS
        select RT_USING_DFS_ELMFAT
        default n

    config BSP_USING_OV2640
        bool "Enable camera (ov2640)"
        select BSP_USING_DCMI
        select BSP_USING_I2C
        select BSP_USING_I2C2
        default n

endmenu

menu "On-chip Peripheral Drivers"

    config BSP_USING_GPIO
        bool "Enable GPIO"
        select RT_USING_PIN
        default y

    menuconfig BSP_USING_UART
        bool "Enable UART"
        default y
        select RT_USING_SERIAL
        if BSP_USING_UART
            config BSP_STM32_UART_V1_TX_TIMEOUT
                int "UART TX timeout"
                default 6000
                depends on RT_USING_SERIAL_V1
                
            menuconfig BSP_USING_UART1
                bool "Enable UART1"
                default y
                if BSP_USING_UART1
                    config BSP_UART1_RX_BUFSIZE
                        int "Set UART1 RX buffer size"
                        range 64 65535
                        depends on RT_USING_SERIAL_V2
                        default 256

                    config BSP_UART1_TX_BUFSIZE
                        int "Set UART1 TX buffer size"
                        range 0 65535
                        depends on RT_USING_SERIAL_V2
                        default 0 
                    
                    config BSP_UART1_DMA_PING_BUFSIZE
                        int "Set UART1 RX DMA ping-pong buffer size"
                        range 32 65535
                        depends on RT_USING_SERIAL_V2 && BSP_UART1_RX_USING_DMA
                        default 64   
                endif

            menuconfig BSP_USING_UART2
                bool "Enable UART2"
                default n
                if BSP_USING_UART2
                    config BSP_UART2_RX_USING_DMA
                        bool "Enable UART2 RX DMA"
                        depends on BSP_USING_UART2 && RT_SERIAL_USING_DMA
                        default n

                    config BSP_UART2_TX_USING_DMA
                        bool "Enable UART2 TX DMA"
                        depends on BSP_USING_UART2 && RT_SERIAL_USING_DMA
                        default n

                    config BSP_UART2_RX_BUFSIZE
                        int "Set UART2 RX buffer size"
                        range 64 65535
                        depends on RT_USING_SERIAL_V2
                        default 256

                    config BSP_UART2_TX_BUFSIZE
                        int "Set UART2 TX buffer size"
                        range 0 65535
                        depends on RT_USING_SERIAL_V2
                        default 0

                    config BSP_UART2_DMA_PING_BUFSIZE
                        int "Set UART2 RX DMA ping-pong buffer size"
                        range 32 65535
                        depends on RT_USING_SERIAL_V2 && BSP_UART2_RX_USING_DMA
                        default 64                        
                endif
        endif

    config BSP_USING_FMC
        bool
        default n

    config BSP_USING_LTDC
        bool
        default n

    menuconfig BSP_USING_SPI
        bool "Enable SPI BUS"
        default n
        select RT_USING_SPI
        if BSP_USING_SPI
            config BSP_USING_SPI2
                bool "Enable SPI2 BUS"
                default n
        endif

    config BSP_USING_QSPI
        bool "Enable QSPI BUS"
        select RT_USING_QSPI
        select RT_USING_SPI
        default n

    menuconfig BSP_USING_I2C
    bool "Enable I2C BUS (software simulation)"
    select RT_USING_I2C
    select RT_USING_I2C_BITOPS
    select RT_USING_PIN
    default n
    if BSP_USING_I2C
        menuconfig BSP_USING_I2C1
            bool "Enable I2C1 BUS (software simulation)"
            default n
            if BSP_USING_I2C1
                comment "Notice: PH4 --> 116; PH5 --> 117"
                config BSP_I2C1_SCL_PIN
                    int "i2c1 scl pin number"
                    range 1 176
                    default 116
                config BSP_I2C1_SDA_PIN
                    int "I2C1 sda pin number"
                    range 1 176
                    default 117
            endif

            menuconfig BSP_USING_I2C2
            bool "Enable I2C2 BUS (software simulation)"
            default n
            if BSP_USING_I2C2
                comment "Notice: PH13 --> 125; PH15 --> 127"
                config BSP_I2C2_SCL_PIN
                    int "i2c2 scl pin number"
                    range 1 176
                    default 127
                config BSP_I2C2_SDA_PIN
                    int "I2C2 sda pin number"
                    range 1 176
                    default 125
            endif
    endif

    config BSP_USING_ON_CHIP_FLASH
        bool "Enable on-chip FLASH"
        default n

    config BSP_USING_DCMI
        bool "Enable DCMI"
        default n

    menuconfig BSP_USING_ONCHIP_RTC
        bool "Enable RTC"
        select RT_USING_RTC
        default n
        if BSP_USING_ONCHIP_RTC
            choice
                prompt "Select clock source"
                default BSP_RTC_USING_LSE

                config BSP_RTC_USING_LSE
                    bool "RTC USING LSE"

                config BSP_RTC_USING_LSI
                    bool "RTC USING LSI"
            endchoice
        endif

    menuconfig BSP_USING_PWM
        bool "Enable PWM"
        default n
        select RT_USING_PWM
        if BSP_USING_PWM
            menuconfig BSP_USING_PWM1
                bool "Enable timer1 output pwm"
                default n
                if BSP_USING_PWM1
                    config BSP_USING_PWM1_CH1
                        bool "Enable PWM1 channel1 (PA8)"
                        default n
                    config BSP_USING_PWM1_CH2
                        bool "Enable PWM1 channel2 (PE11)"
                        default n
                    config BSP_USING_PWM1_CH3
                        bool "Enable PWM1 channel3 (PE13)"
                        default n
                    config BSP_USING_PWM1_CH4
                        bool "Enable PWM1 channel4 (PE14)"
                        default n
                endif
            menuconfig BSP_USING_PWM4
                bool "Enable timer4 output pwm"
                default n
                if BSP_USING_PWM4
                    config BSP_USING_PWM4_CH3
                        bool "Enable PWM4 channel3 (PD14)"
                        default n
                    config BSP_USING_PWM4_CH4
                        bool "Enable PWM4 channel4 (PD15)"
                        default n
                endif
            menuconfig BSP_USING_PWM5
                bool "Enable timer5 output pwm"
                default n
                if BSP_USING_PWM5
                    config BSP_USING_PWM5_CH1
                        bool "Enable PWM5 channel1 (PA0)"
                        default n
                    config BSP_USING_PWM5_CH2
                        bool "Enable PWM5 channel2 (PA1)"
                        default n
                endif
        endif

    menuconfig BSP_USING_ADC
        bool "Enable ADC"
        default n
        select RT_USING_ADC
        if BSP_USING_ADC
            config BSP_USING_ADC1
                bool "Enable ADC1"
                default n
        endif

    menuconfig BSP_USING_DAC
        bool "Enable DAC"
        default n
        select RT_USING_DAC
        if BSP_USING_DAC
            config BSP_USING_DAC1
                bool "Enable DAC1"
                default n
        endif

    config BSP_USING_WDT
        bool "Enable Watchdog Timer"
        select RT_USING_WDT
        default n

    config BSP_USING_USB_DEVICE
        bool "Enable USB Device (CDC virtual serial)"
        select RT_USING_CHERRYUSB
        select RT_CHERRYUSB_DEVICE
        select RT_CHERRYUSB_DEVICE_DWC2_ST
        select RT_CHERRYUSB_DEVICE_CDC_ACM
        select RT_CHERRYUSB_DEVICE_CDC_ACM_CHARDEV
        select RT_CHERRYUSB_DEVICE_TEMPLATE_CDC_ACM_CHARDEV
        default y

    source "$(BSP_DIR)/../libraries/HAL_Drivers/drivers/Kconfig"

endmenu

menu "Board extended module Drivers"

endmenu

endmenu
```
